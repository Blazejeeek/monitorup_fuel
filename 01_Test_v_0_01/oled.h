// Minimalny sterownik SSD1306 128x64 (I2C) z czcionka 5x7 - bez zewnetrznych bibliotek.
#pragma once
#include <Arduino.h>
#include <Wire.h>

static const uint8_t FONT5X7[][5] PROGMEM = {
  {0x00,0x00,0x00,0x00,0x00},{0x00,0x00,0x5F,0x00,0x00},{0x00,0x07,0x00,0x07,0x00},{0x14,0x7F,0x14,0x7F,0x14}, //  !"#
  {0x24,0x2A,0x7F,0x2A,0x12},{0x23,0x13,0x08,0x64,0x62},{0x36,0x49,0x55,0x22,0x50},{0x00,0x05,0x03,0x00,0x00}, // $%&'
  {0x00,0x1C,0x22,0x41,0x00},{0x00,0x41,0x22,0x1C,0x00},{0x08,0x2A,0x1C,0x2A,0x08},{0x08,0x08,0x3E,0x08,0x08}, // ()*+
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  {0x00,0x00,0x7F,0x00,0x00},{0x00,0x41,0x36,0x08,0x00},{0x02,0x01,0x02,0x04,0x02}                             // |}~
};

class MiniOLED {
public:
  bool ok = false;

  bool begin(TwoWire &w, uint8_t addr = 0x3C) {
    _w = &w; _addr = addr;
    _w->beginTransmission(_addr);
    if (_w->endTransmission() != 0) { ok = false; return false; }
    static const uint8_t init[] = {
      0xAE, 0xD5, 0x80, 0xA8, 0x3F, 0xD3, 0x00, 0x40, 0x8D, 0x14, 0x20, 0x00,
      0xA1, 0xC8, 0xDA, 0x12, 0x81, 0xCF, 0xD9, 0xF1, 0xDB, 0x40, 0xA4, 0xA6, 0xAF
    };
    for (uint8_t c : init) cmd(c);
    ok = true;
    clear(); display();
    return true;
  }

  void clear() { memset(_buf, 0, sizeof(_buf)); }
  void fill(uint8_t v) { memset(_buf, v, sizeof(_buf)); }
  void invert(bool on) { if (ok) cmd(on ? 0xA7 : 0xA6); }

  // col: 0..20 (znaki 6 px), row: 0..7 (strony 8 px)
  void text(uint8_t col, uint8_t row, const char *s) {
    if (row > 7) return;
    uint16_t x = col * 6;
    while (*s && x <= 122) {
      char c = *s++;
      if (c < 32 || c > 126) c = '?';
      for (uint8_t i = 0; i < 5; i++) _buf[row * 128 + x + i] = pgm_read_byte(&FONT5X7[c - 32][i]);
      _buf[row * 128 + x + 5] = 0;
      x += 6;
    }
  }

  void display() {
    if (!ok) return;
    cmd(0x21); cmd(0); cmd(127);
    cmd(0x22); cmd(0); cmd(7);
    for (uint16_t i = 0; i < sizeof(_buf); i += 16) {
      _w->beginTransmission(_addr);
      _w->write(0x40);
      _w->write(&_buf[i], 16);
      if (_w->endTransmission() != 0) { ok = false; return; }
    }
  }

private:
  TwoWire *_w = nullptr;
  uint8_t _addr = 0x3C;
  uint8_t _buf[1024];
  void cmd(uint8_t c) {
    _w->beginTransmission(_addr);
    _w->write(0x00);
    _w->write(c);
    _w->endTransmission();
  }
};
